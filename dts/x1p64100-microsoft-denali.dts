// SPDX-License-Identifier: BSD-3-Clause
/*
 * Copyright (c) 2025 Dale Whinham <daleyo@gmail.com>
 */

/dts-v1/;

#include "hamoa.dtsi"
#include "x1-microsoft-denali.dtsi"

/ {
	model = "Microsoft Surface Pro 11th Edition (LCD)";
	compatible = "microsoft,denali-lcd", "microsoft,denali",
		     "qcom,x1p64100", "qcom,x1e80100";
};

&panel {
	compatible = "edp-panel";
	enable-gpios = <&pmc8380_3_gpios 4 GPIO_ACTIVE_HIGH>;
	pinctrl-0 = <&edp_bl_en>;
	pinctrl-names = "default";
};
